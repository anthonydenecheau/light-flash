## common/lib/wifi_ap/sdkconfig.defaults
```kconfig
CONFIG_ESP_MAIN_TASK_STACK_SIZE=20000
CONFIG_ESP_SYSTEM_EVENT_TASK_STACK_SIZE=4096
CONFIG_ESP_WIFI_SOFTAP_SUPPORT=y
CONFIG_LWIP_ENABLE_NETIF_HOSTNAME=1
CONFIG_LWIP_LOCAL_HOSTNAME="light"
```
